## Documentation/devicetree/bindings/display/mediatek/mediatek,dsi.txt
```
Mediatek DSI Device
===================

The Mediatek DSI function block is a sink of the display subsystem and can
drive up to 4-lane MIPI DSI output. Two DSIs can be synchronized for dual-
channel output.

Required properties:
- compatible: "mediatek,<chip>-dsi"
- reg: Physical base address and length of the controller's registers
- interrupts: The interrupt signal from the function block.
- clocks: device clocks
  See Documentation/devicetree/bindings/clock/clock-bindings.txt for details.
- clock-names: must contain "engine" and "digital".
- phys: phandle link to the MIPI D-PHY controller.
- phy-names: must contain "dphy"
- port: Output port node with endpoint definitions as described in
  Documentation/devicetree/bindings/graph.txt. This port should be connected
  to the input port of an attached DSI panel or DSI-to-eDP encoder chip.

MIPI TX Configuration Module
============================

The MIPI TX configuration module controls the MIPI D-PHY.

Required properties:
- compatible: "mediatek,<chip>-mipi-tx"
- reg: Physical base address and length of the controller's registers
- #phy-cells: must be <0>.

Example:

mipi_tx0: mipi-dphy@10215000 {
	compatible = "mediatek,mt8173-mipi-tx";
	reg = <0 0x10215000 0 0x1000>;
	#phy-cells = <0>;
};

dsi0: dsi@1401b000 {
	compatible = "mediatek,mt8173-dsi";
	reg = <0 0x1401b000 0 0x1000>;
	interrupts = <GIC_SPI 192 IRQ_TYPE_LEVEL_LOW>;
	clocks = <&mmsys MM_DSI0_ENGINE>, <&mmsys MM_DSI0_DIGITAL>;
	clock-names = "engine", "digital";
	phys = <&mipi_tx0>;
	phy-names = "dphy";

	port {
		dsi0_out: endpoint {
			remote-endpoint = <&panel_in>;
		};
	};
};
```

## Documentation/devicetree/bindings/drm/mediatek/mediatek,crtc-main.txt
```
Mediatek CRTC Main Device
================================

The Mediatek CRTC Main device is a crtc device of DRM system.

Required properties:
- compatible: "mediatek,<chip>-crtc-main"
- interrupts: The interrupt signal from the CRTC Main block.
- reg: Physical base address and length of the controller's registers
- clocks: device clocks
  See Documentation/devicetree/bindings/clock/clock-bindings.txt for details.
- ddp: phandle of ddp device which control display data path.

Example:

crtc_main: crtc@1400c000 {
	compatible = "mediatek,mt8173-crtc-main";
	interrupts = <GIC_SPI 196 IRQ_TYPE_LEVEL_LOW>;
	reg = <0 0x1400c000 0 0x1000>,	/* OVL0 */
	      <0 0x1400e000 0 0x1000>,	/* RDMA0 */
	      <0 0x14013000 0 0x1000>,	/* COLOR0 */
	      <0 0x14015000 0 0x1000>,	/* AAL */
	      <0 0x1401a000 0 0x1000>,	/* UFOE */
	      <0 0x14023000 0 0x1000>;	/* OD */
	clocks = <&mmsys MM_DISP_OVL0>,
		 <&mmsys MM_DISP_RDMA0>,
		 <&mmsys MM_DISP_COLOR0>,
		 <&mmsys MM_DISP_AAL>,
		 <&mmsys MM_DISP_UFOE>,
		 <&mmsys MM_DISP_OD>;
	clock-names = "ovl0_disp",
		      "rdma0_disp",
		      "color0_disp",
		      "aal_disp",
		      "ufoe_disp",
		      "od_disp";
	ddp = <&ddp>;
};
```

## Documentation/devicetree/bindings/drm/mediatek/mediatek,ddp.txt
```
Mediatek DDP Device
================================

The Mediatek DDP device control the display data path.

Required properties:
- compatible: "mediatek,<chip>-ddp"
- reg: Physical base address and length of the controller's registers
- power-domains: a phandle to DDP power domain node.
- clocks: device clocks
  See Documentation/devicetree/bindings/clock/clock-bindings.txt for details.

Example:

ddp: ddp@14000000 {
	compatible = "mediatek,mt8173-ddp";
	reg = <0 0x14000000 0 0x100>,	/* CONFIG */
	      <0 0x14020000 0 0x1000>;	/* MUTEX */
	power-domains = <&scpsys MT8173_POWER_DOMAIN_DIS>;
	clocks = <&mmsys MM_MUTEX_32K>;
	clock-names = "mutex_disp";
};
```

## Documentation/devicetree/bindings/drm/mediatek/mediatek,drm.txt
```
Mediatek DRM Device
================================

The Mediatek DRM device is a device needed to list all
display component nodes that comprise the display subsystem.
And it list the memory-related interface.

Required properties:
- compatible: "mediatek,<chip>-drm"
- larb: Should contain a list of phandles pointing to larb device.
  larb definitions as defined in
  Documentation/devicetree/bindings/soc/mediatek/mediatek,smi-larb.txt
- iommus: required a iommu node
- connectors: Should contain a list of phandles pointing to connector device.
  connector device should be one component of this master.
- crtcs: Should contain a list of phandles pointing to crtc device.
  crtc device should be one component of this master.

Example:

drm0: drm {
	compatible = "mediatek,mt8173-drm";
	larb = <&larb0>;
	iommus = <&iommu M4U_PORT_DISP_OVL0>;
	connectors = <&dsi>;
	crtcs = <&crtc_main>;
};
```

## Documentation/devicetree/bindings/drm/mediatek/mediatek,dsi.txt
```
Mediatek DSI Device
================================

The Mediatek DSI device is a connector device of DRM system.

Required properties:
- compatible: "mediatek,<chip>-dsi"
- reg: Physical base address and length of the controller's registers
- clocks: device clocks
  See Documentation/devicetree/bindings/clock/clock-bindings.txt for details.

Example:

dsi: dsi@10215000 {
	compatible = "mediatek,mt8173-dsi";
	reg = <0 0x1401B000 0 0x1000>,	/* DSI0 */
	      <0 0x10215000 0 0x1000>;  /* MIPITX */
	clocks = <&mmsys MM_DSI0_ENGINE>,	<&mmsys MM_DSI0_DIGITAL>;
	clock-names = "dsi0_engine_disp_ck", "dsi0_digital_disp_ck";
};
```

## Documentation/devicetree/bindings/iommu/mediatek,iommu.txt
```
* Mediatek IOMMU Architecture Implementation

  Mediatek Socs may contain a implementation of Multimedia Memory
Management Unit(M4U),which use ARM Short-descriptor translation table
to achieve address translation.

  The IOMMU Hardware Block Diagram, please check below:

              EMI (External Memory Interface)
               |
              m4u (Multimedia Memory Management Unit)
               |
              smi (Smart Multimedia Interface)
               |
        +---------------+-------
        |               |
        |               |
    vdec larb       disp larb      ... SoCs have different local arbiter(larb).
        |               |
        |               |
   +----+----+    +-----+-----+
   |    |    |    |     |     |    ...
   |    |    |    |     |     |    ...
   |    |    |    |     |     |    ...
  MC   PP   VLD  OVL0 RDMA0 WDMA0  ... There are different ports in each larb.

  As above, The Multimedia HW will go through SMI and M4U while it
access EMI. SMI is a brige between m4u and the Multimedia HW. It contain
smi local arbiter and smi common. It will control whether the Multimedia
HW should go though the m4u for translation or bypass it and talk
directly with EMI. And also SMI help control the clocks for each
local arbiter.
  Normally we specify a local arbiter(larb) for each multimedia HW
like display, video decode, and camera. And there are different ports
in each larb. Take a example, There are some ports like MC, PP, VLD in the
video decode local arbiter, all the ports are according to the video HW.

Required properties:
- compatible : must be "mediatek,mt8173-m4u".
- reg : m4u register base and size.
- interrupts : the interrupt of m4u.
- clocks : must contain one entry for each clock-names.
- clock-names : must be "bclk", It is the block clock of m4u.
- mediatek,larb : List of phandle to the local arbiters in the current Socs.
	Refer to bindings/memory-controllers/mediatek,smi-larb.txt. It must sort
	according to the local arbiter index, like larb0, larb1, larb2...
- iommu-cells : must be 2. There are 2 cells needed to enable/disable iommu.
	The first one is local arbiter index(larbid), and the other is port
	index(portid) within local arbiter. Specifies the larbid and portid as
	defined in dt-binding/memory/mt8173-larb-port.h.

Example:
	iommu: iommu@10205000 {
		compatible = "mediatek,mt8173-m4u";
		reg = <0 0x10205000 0 0x1000>;
		interrupts = <GIC_SPI 139 IRQ_TYPE_LEVEL_LOW>;
		clocks = <&infracfg CLK_INFRA_M4U>;
		clock-names = "bclk";
		mediatek,larb = <&larb0 &larb1 &larb2 &larb3 &larb4 &larb5>;
		#iommu-cells = <2>;
	};
```

## Documentation/devicetree/bindings/soc/mediatek/cmdq.txt
```
MediaTek CMDQ
===============

The Command Queue (CMDQ) is used to help read/write registers with critical
time limitation, such as updating display configuration during the vblank.
It controls Global Command Engine (GCE) hardware to achieve this requirement.
Currently, CMDQ only supports display related hardwares, but we expect it can
be extended to other hardwares for future requirements.

Required properties:
- compatible: Must be "mediatek,mt8173-gce"
- reg: Address range of the GCE unit
- interrupts: The interrupt signal from the GCE block
- clock: Clocks according to the common clock binding
- clock-names: Must be "gce" to stand for GCE clock

Example:

	gce: gce@10212000 {
		compatible = "mediatek,mt8173-gce";
		reg = <0 0x10212000 0 0x1000>;
		interrupts = <GIC_SPI 135 IRQ_TYPE_LEVEL_LOW>;
		clocks = <&infracfg CLK_INFRA_GCE>;
		clock-names = "gce";
	};
```
